## rootfs/public/acm/Kconfig
```kconfig
config TARGET_PACKAGE_ACM_SCRIPT
        bool "Target package acm script"
        default n
        help
          target package acm script
```

## rootfs/public/aic8800d80/Kconfig
```kconfig
config TARGET_PACKAGE_AIC8800D80
	bool "Target package of AIC8800D80 firmware files"
	default n
	help
	  target package of AIC8800D80 firmware and configuration files
	  Do not enable this option together with TARGET_PACKAGE_AIC8800DC,
	  because both packages install files to /mnt/system/firmware/aic8800.
```

## rootfs/public/aic8800dc/Kconfig
```kconfig
config TARGET_PACKAGE_AIC8800DC
	bool "Target package of AIC8800DC firmware files"
	default n
	help
	  target package of AIC8800DC firmware and configuration files
	  Do not enable this option together with TARGET_PACKAGE_AIC8800D80,
	  because both packages install files to /mnt/system/firmware/aic8800.
```

## rootfs/public/cvi_ab_boot/Kconfig
```kconfig
config TARGET_PACKAGE_AB_BOOT
	bool "Target package cvi_ab_boot"
	default n
	help
	  target cvi_ab_boot
```

## rootfs/public/dnsmasq/Kconfig
```kconfig
config TARGET_PACKAGE_DNSMASQ
	bool "Target package dnsmasq"
	default n
	help
		target package dnsmasq
```

## rootfs/public/ncm/Kconfig
```kconfig
config TARGET_PACKAGE_NCM_SCRIPT
        bool "Target package ncm script"
        default n
        help
          target package ncm script
```

## rootfs/public/python3.10/Kconfig
```kconfig
config TARGET_PACKAGE_PYTHON3.10
	bool "Target package python3.10"
	default n
	help
	  target package python3.10
```
